## br_external_easyperf/Config.in
```kconfig
menu "External options"
    source "$BR2_EXTERNAL_EASYP_PATH/package/arcane_tests/Config.in"
    source "$BR2_EXTERNAL_EASYP_PATH/package/dinov2_linux/Config.in"
endmenu
```

## br_external_easyperf/package/arcane_tests/Config.in
```kconfig
config BR2_PACKAGE_ARCANE_TESTS
	bool "arcane_tests"
	help
	  Userspace functional test for ARCANE matrix extension.
```

## br_external_easyperf/package/dinov2_linux/Config.in
```kconfig
config BR2_PACKAGE_DINOV2_LINUX
	bool "dinov2_linux"
	help
	  DINOv2 Small ViT inference app with ARCANE acceleration.
```

## br_external_easyperf/package/easyperf/Config.in
```kconfig
config BR2_PACKAGE_EASYPERF
    bool "easyperf"
    help
      Simple performance tool from https://github.com/Vincenzo-Petrolo/easyperf
```

## br_external_easyperf/package/matmul/Config.in
```kconfig
config BR2_PACKAGE_MATMUL
    bool "matmul"
    help
      Simple matrix multiplication benchmark
```

## br_external_easyperf/package/mobilenet_linux/Config.in
```kconfig
config BR2_PACKAGE_MOBILENET_LINUX
	bool "mobilenet_linux"
	help
	  MobilenetV2 Inference app running on ARCANE.
```
